## drivers/media/video/sensortherm/Kconfig
```kconfig
#
# Generic video config states
#

config DAVINCI_LCD_DM355
	tristate "davinci lcd dm355"
	help
	  This driver read all registers from the lcd.


config DAVINCI_READ_REGS
	tristate "davinci read regs"
	depends on SOC_CAMERA && I2C && VIDEO_V4L2
	help
	  This driver read all registers from dm355.

config SOC_CAMERA_MT9V126
	tristate "mt9v126 support"
	depends on SOC_CAMERA && I2C && VIDEO_V4L2
	help
	  This driver supports MT9V126 cameras from Micron.

config SOC_CAMERA_MT9V113
	tristate "Aptina MT9V113 VGA CMOS IMAGE SENSOR"
	depends on VIDEO_V4L2 && I2C
	---help---
	  This is a Video4Linux2 sensor-level driver for the Aptina MT9V113
	  image sensor. It is currently working with the TI DAVINCI DM355
	  processor.

	  To compile this driver as a module, choose M here: the
	  module will be called mt9v113_davinci.
```

## drivers/ti/Kconfig
```kconfig
config TI_MODULES
	depends on ARCH_DAVINCI_DM365
	bool "TI cmemk, irqk, edmak and dm365mmap kernel module"
	help
	  TI cmemk, irqk, edmak and dm365mmap kernel module.
	  Borrowed from TI DVSDK 4
```
